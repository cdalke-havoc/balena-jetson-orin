## layers/meta-balena-jetson/conf/machine/jetson-orin-nano-4gb-forecr.conf
```bitbake
#@TYPE: Machine
#@NAME: Jetson Orin Nano 4GB in ForeCR DSBOARD-ORNX-LAN
##@DESCRIPTION: Jetson Orin Nano 4GB in ForeCR DSBOARD-ORNX-LAN
#

MACHINEOVERRIDES = "jetson-orin-nano-4gb-forecr:${MACHINE}"
include conf/machine/p3768-0000-p3767-0004.conf

# work-around for https://github.com/OE4T/meta-tegra/issues/400
MACHINEOVERRIDES := "${@'${MACHINEOVERRIDES}'.replace(':${MACHINE}',':jetson-orin-nano-4gb-forecr:${MACHINE}')}"
```

## layers/meta-balena-jetson/conf/machine/jetson-orin-nano-8gb-forecr.conf
```bitbake
#@TYPE: Machine
#@NAME: Jetson Orin Nano 8GB in ForeCR DSBOARD-ORNX-LAN
##@DESCRIPTION: Jetson Orin Nano 8GB in ForeCR DSBOARD-ORNX-LAN
#

MACHINEOVERRIDES = "jetson-orin-nano-8gb-forecr:${MACHINE}"
include conf/machine/p3768-0000-p3767-0003.conf

# work-around for https://github.com/OE4T/meta-tegra/issues/400
MACHINEOVERRIDES := "${@'${MACHINEOVERRIDES}'.replace(':${MACHINE}',':jetson-orin-nano-8gb-forecr:${MACHINE}')}"
```
